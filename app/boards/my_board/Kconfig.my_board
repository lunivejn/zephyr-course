## app/boards/my_board/Kconfig.my_board
```kconfig
# Copyright (c) 2023-2025 Espressif Systems (Shanghai) Co., Ltd.
# SPDX-License-Identifier: Apache-2.0

config BOARD_MY_BOARD
    bool "My Board"
    select SOC_ESP32_WROVER_E_N4R8
```

## app/boards/new_board/Kconfig.new_board
```kconfig
# Copyright (c) 2023-2025 Espressif Systems (Shanghai) Co., Ltd.
# SPDX-License-Identifier: Apache-2.0

config BOARD_NEW_BOARD
    bool "New Board"
    select SOC_ESP32_WROVER_E_N4R8
```

## dts/bindings/our,driver.yaml
```yaml
description: "Our simple GPIO driver"
compatible: "our,driver"
include: "base.yaml"
```

## twister-out/native_sim_native/host/homework.unit.ring_buf/Kconfig/arch/Kconfig
```kconfig
# Load Zephyr Arch Kconfig descriptions.
osource "/home/luni/workspace/deps/zephyr/arch/rx/Kconfig"
osource "/home/luni/workspace/deps/zephyr/arch/x86/Kconfig"
osource "/home/luni/workspace/deps/zephyr/arch/xtensa/Kconfig"
osource "/home/luni/workspace/deps/zephyr/arch/sparc/Kconfig"
osource "/home/luni/workspace/deps/zephyr/arch/riscv/Kconfig"
osource "/home/luni/workspace/deps/zephyr/arch/posix/Kconfig"
osource "/home/luni/workspace/deps/zephyr/arch/mips/Kconfig"
osource "/home/luni/workspace/deps/zephyr/arch/arm64/Kconfig"
osource "/home/luni/workspace/deps/zephyr/arch/arm/Kconfig"
osource "/home/luni/workspace/deps/zephyr/arch/arc/Kconfig"
```

## twister-out/native_sim_native/host/homework.unit.ring_buf/Kconfig/boards/Kconfig
```kconfig
# Load Zephyr board Kconfig descriptions.
osource "/home/luni/workspace/deps/zephyr/boards/native/native_sim/Kconfig"
```

## twister-out/native_sim_native/host/homework.unit.ring_buf/Kconfig/boards/Kconfig.defconfig
```kconfig
# Load Zephyr board defconfig descriptions.
osource "/home/luni/workspace/deps/zephyr/boards/native/native_sim/Kconfig.defconfig"
```

## twister-out/native_sim_native/host/homework.unit.ring_buf/Kconfig/boards/Kconfig.native_sim
```kconfig
# Load board Kconfig descriptions.
osource "/home/luni/workspace/deps/zephyr/boards/native/native_sim/Kconfig.native_sim"
```

## twister-out/native_sim_native/host/homework.unit.ring_buf/Kconfig/boards/Kconfig.sysbuild
```kconfig
# Load Sysbuild board Kconfig descriptions.
osource "/home/luni/workspace/deps/zephyr/boards/native/native_sim/Kconfig.sysbuild"
```
